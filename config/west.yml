## config/west.yml
```yaml
manifest:
  remotes:
    - name: zmkfirmware
      url-base: https://github.com/zmkfirmware
    - name: infused-kim
      url-base: https://github.com/infused-kim
  projects:
   - name: zmk
     remote: infused-kim
     revision: aa-my-customizations-z3
     import: app/west.yml
#     - name: zmk
#       remote: zmkfirmware
#       revision: main
#       import: app/west.yml
  self:
    path: config
```
